## subsys/smp_lbm/Kconfig
```kconfig
#
# Copyright (c) 2024, Jamie McCrae
#
# SPDX-License-Identifier: Apache-2.0
#

# The Kconfig file is dedicated to the LBM transport of MCUmgr
# subsystem and provides Kconfig options to control aspects of
# the transport.
#
# Options defined in this file should be prefixed:
#  MCUMGR_TRANSPORT_LBM_

menuconfig MCUMGR_TRANSPORT_LBM
	bool "LBM MCUmgr SMP transport"
	depends on LORA_BASICS_MODEM
	help
	  Enables handling of SMP commands received over LBM.

if MCUMGR_TRANSPORT_LBM

config MCUMGR_TRANSPORT_LBM_FRAME_PORT
	int "LBM SMP frame port"
	range 1 223
	default 2
	help
	  LBM download and uplink frame port used for communication. All messages received on
	  this port will be treated as SMP packets.

config MCUMGR_TRANSPORT_LBM_CONFIRMED_UPLINKS
	bool "Use confirmed packets for uplinks"
	default y
	help
	  Will use confirmed uplink packets for responses if enabled, otherwise will use
	  unconfirmed packets.

config MCUMGR_TRANSPORT_LBM_REASSEMBLY
	bool "Reassemble LBM SMP messages"
	select MCUMGR_TRANSPORT_REASSEMBLY
	default y
	help
	  Will reassemble downlink LBM messages together to allow for messages larger than a
	  single message to be received, otherwise will support messages up to a single packet in
	  size.

menuconfig MCUMGR_TRANSPORT_LBM_POLL_FOR_DATA
	bool "Send empty packet if partial packet received"
	depends on MCUMGR_TRANSPORT_LBM_REASSEMBLY
	default y
	help
	  Will send an empty packet if a partial (fragmented) message has been received from the
	  server, this will allow the next packet to be received without waiting for next
	  transmission window.

	  Note: this requires a dedicated thread in order to prevent blocking the system workqueue.

if MCUMGR_TRANSPORT_LBM_POLL_FOR_DATA

config MCUMGR_TRANSPORT_LBM_POLL_FOR_DATA_STACK_SIZE
	int "Poll thread stack size"
	default 1800
	help
	  Stack size of the thread that will poll for empty additional packets when a partial
	  frame is received.

config MCUMGR_TRANSPORT_LBM_POLL_FOR_DATA_THREAD_PRIORITY
	int "Poll thread priority"
	default 3
	help
	  Priority of the thread for polling for empty additional packets when a partial frame
	  is received.

config MCUMGR_TRANSPORT_LBM_POLL_FOR_DATA_RETRIES
	int "Poll thread retries"
	default 3
	help
	  Number of LBM message send retries if sending fails for the thread for polling for
	  empty additional packets when a partial frame is received.

endif # MCUMGR_TRANSPORT_LBM_POLL_FOR_DATA

config MCUMGR_TRANSPORT_LBM_FRAGMENTED_UPLINKS
	bool "Fragment uplink messages"
	default y
	help
	  Will fragment messages into multiple uplink messages if they are too big to fit into a
	  single uplink message. If disabled then uplinks that are too large will not be sent.

module = MCUMGR_TRANSPORT_LBM
module-str = LBM MCUmgr SMP transport
source "subsys/logging/Kconfig.template.log_config"

endif # MCUMGR_TRANSPORT_LBM
```

## west.yml
```yaml
# Copyright (c) 2024 Semtech Corporation
# SPDX-License-Identifier: Apache-2.0

manifest:
  projects:
    - name: zephyr
      url: https://github.com/nrfconnect/sdk-zephyr
      revision: v3.7.99-ncs1
      import: true

    - name: lora_basics_modem
      path: modules/lib/lora_basics_modem
      url: https://github.com/lora-net/SWL2001
      revision: v4.8.0

  self:
    path: application
```
