## CMakeLists.txt
```
# Copyright (c) 2024 Semtech Corporation - Félix Piédallu
# SPDX-License-Identifier: Apache-2.0

cmake_minimum_required(VERSION 3.13.1)

# create compile_commands.json for clang
set(CMAKE_EXPORT_COMPILE_COMMANDS on)

find_package(Zephyr HINTS $ENV{ZEPHYR_BASE})
project(hw_modem)

zephyr_compile_options(-fdiagnostics-color=always)

zephyr_include_directories(src)
target_sources(app PRIVATE src/main_periodical_uplink.c)
target_sources_ifdef(CONFIG_MCUMGR_TRANSPORT_BT app PRIVATE src/bluetooth.c)


# Based on some LBM features, different flags are used in the sample for some
# reason, so we map to them here.
zephyr_compile_definitions_ifdef(CONFIG_LORA_BASICS_MODEM_GEOLOCATION
                                 ADD_APP_GEOLOCATION)

zephyr_compile_definitions_ifdef(LORA_BASICS_MODEM_CRYPTOGRAPHY_LR11XX
                                 USE_LR11XX_CRYPTO)
zephyr_compile_definitions_ifdef(
  LORA_BASICS_MODEM_CRYPTOGRAPHY_LR11XX_WITH_CREDENTIALS USE_LR11XX_CRYPTO)

zephyr_compile_definitions_ifdef(CONFIG_LORA_BASICS_MODEM_RELAY_TX_ENABLE
                                 USE_RELAY_TX)
```

## prj.conf
```kconfig
# Copyright (c) 2024 Semtech Corporation - Félix Piédallu
# SPDX-License-Identifier: Apache-2.0

CONFIG_USE_SEGGER_RTT=n

# ------------------------------ MCUBoot configuration ------------------------------

CONFIG_BOOTLOADER_MCUBOOT=y
CONFIG_MCUBOOT_SIGNATURE_KEY_FILE="bootloader/mcuboot/root-rsa-2048.pem"

# ---------------------------- SMP Server Functionality -----------------------------

# Enable MCUmgr and dependencies.
CONFIG_NET_BUF=y
CONFIG_ZCBOR=y
CONFIG_CRC=y
CONFIG_MCUMGR=y
CONFIG_STREAM_FLASH=y
CONFIG_FLASH_MAP=y

# Some command handlers require a large stack.
CONFIG_SYSTEM_WORKQUEUE_STACK_SIZE=2304
CONFIG_MAIN_STACK_SIZE=2048

# Ensure an MCUboot-compatible binary is generated.
CONFIG_BOOTLOADER_MCUBOOT=y
CONFIG_MCUBOOT_SIGNATURE_KEY_FILE="bootloader/mcuboot/root-rsa-2048.pem"

# Enable (external) flash operations.
CONFIG_FLASH=y

CONFIG_NORDIC_QSPI_NOR=y
CONFIG_NORDIC_QSPI_NOR_FLASH_LAYOUT_PAGE_SIZE=4096

# Required by the `taskstat` command.
CONFIG_THREAD_MONITOR=y

# Support for taskstat command
CONFIG_MCUMGR_GRP_OS_TASKSTAT=y

# Enable statistics and statistic names.
#CONFIG_STATS=y
#CONFIG_STATS_NAMES=y

# Enable most core commands.
CONFIG_FLASH=y
CONFIG_IMG_MANAGER=y
CONFIG_MCUMGR_GRP_IMG=y
CONFIG_MCUMGR_GRP_OS=y
CONFIG_MCUMGR_GRP_STAT=y

# Turn on heap_info (for debugging only)
CONFIG_SYS_HEAP_INFO=y

# Related to the smp_lbm transport
CONFIG_MCUMGR_TRANSPORT_LBM=y
CONFIG_MCUMGR_TRANSPORT_LBM_CONFIRMED_UPLINKS=y
CONFIG_MCUMGR_TRANSPORT_LBM_REASSEMBLY=y
CONFIG_MCUMGR_TRANSPORT_LBM_POLL_FOR_DATA=y
CONFIG_MCUMGR_TRANSPORT_LBM_FRAGMENTED_UPLINKS=y

# Enable logging
# CONFIG_MCUBOOT_UTIL_LOG_LEVEL_WRN=y

# Disable debug logging
CONFIG_LOG_MAX_LEVEL=3

# ------------------------------ General configuration ------------------------------

# required for floorf (which is used within the smtc_modem lib)
CONFIG_NEWLIB_LIBC=y

# stack size (2048 required by Semtech)
CONFIG_MAIN_STACK_SIZE=4096
# some opereations will be triggered from the system workq, so match above stack size
CONFIG_SYSTEM_WORKQUEUE_STACK_SIZE=4096
# heap size
CONFIG_HEAP_MEM_POOL_SIZE=4096

CONFIG_LOG_BUFFER_SIZE=4096

CONFIG_LOG=y
CONFIG_LOG_BACKEND_UART=y

CONFIG_TEST_RANDOM_GENERATOR=y

# CONFIG_SERIAL=y
# CONFIG_UART_INTERRUPT_DRIVEN=y

# ------------------------------ Transceiver driver ----------------------------

CONFIG_LORA_BASICS_MODEM_DRIVERS=y
CONFIG_LORA_BASICS_MODEM_DRIVERS_EVENT_TRIGGER_GLOBAL_THREAD=y

# ------------------------------ Requirements LBM ------------------------------

CONFIG_SETTINGS=y
CONFIG_SETTINGS_NVS=y

CONFIG_NVS=y
CONFIG_FLASH=y
CONFIG_FLASH_MAP=y

CONFIG_REBOOT=y

# ------------------------------ LoRa Basics Modem -----------------------------

CONFIG_LORA_BASICS_MODEM=y

CONFIG_LORA_BASICS_MODEM_RP2_103=y
CONFIG_LORA_BASICS_MODEM_ENABLE_ALL_REGIONS=y

CONFIG_LORA_BASICS_MODEM_CRYPTOGRAPHY_SOFT=n

CONFIG_LORA_BASICS_MODEM_CLASS_B=y
CONFIG_LORA_BASICS_MODEM_CLASS_C=y
CONFIG_LORA_BASICS_MODEM_MULTICAST=y
CONFIG_LORA_BASICS_MODEM_CSMA=n

CONFIG_LORA_BASICS_MODEM_ALC_SYNC=n
CONFIG_LORA_BASICS_MODEM_ALC_SYNC_V2=n

CONFIG_LORA_BASICS_MODEM_FUOTA=y
# CONFIG_LORA_BASICS_MODEM_FUOTA_VERSION_1=y
# CONFIG_LORA_BASICS_MODEM_FUOTA_FMP=y
# CONFIG_LORA_BASICS_MODEM_FUOTA_MPA=y

CONFIG_LORA_BASICS_MODEM_ALMANAC=n
CONFIG_LORA_BASICS_MODEM_STREAM=n
CONFIG_LORA_BASICS_MODEM_LFU=n
CONFIG_LORA_BASICS_MODEM_DEVICE_MANAGEMENT=n
CONFIG_LORA_BASICS_MODEM_GEOLOCATION=n
CONFIG_LORA_BASICS_MODEM_STORE_AND_FORWARD=n
# CONFIG_LORA_BASICS_MODEM_BEACON_TX=y
# CONFIG_LORA_BASICS_MODEM_RELAY_TX=y


CONFIG_LORA_BASICS_MODEM_APP_HELPERS=y

# Increase required for store_and_forward
CONFIG_LORA_BASICS_MODEM_CONTEXT_BUFFER_SIZE=1024

CONFIG_LORA_BASICS_MODEM_MAIN_THREAD=y

# ------------------------------ Debug ------------------------------

# Compiler optimizations will be set to -Og independently of other options.
CONFIG_DEBUG_OPTIMIZATIONS=y

# This option enables the addition of various information that can be
# used by debuggers in debugging the system, or enable additional debugging
# information to be reported at runtime.
CONFIG_DEBUG_INFO=y

# This option adds additional information to the thread object, so that the
# debugger can discover the threads.
CONFIG_DEBUG_THREAD_INFO=y
CONFIG_DEBUG_COREDUMP=y

# enable asserts during development only
CONFIG_ASSERT=n

CONFIG_LORA_BASICS_MODEM_LOG_LEVEL_DBG=y
CONFIG_LORA_BASICS_MODEM_LOG_LEVEL_DEEP_DBG=n

# ------------------------------ Requirements of this sample ------------------------------

CONFIG_PM_DEVICE=y
CONFIG_WATCHDOG=y





# ------------------------------ Requirements of this sample ------------------------------


# Apps common is not ported yet, so we need to disable it
# We do the correct initialization "by hand" in the sample
# CONFIG_LORA_BASICS_MODEM_APPS_COMMON=n
```

## overlay-bt.conf
```kconfig
CONFIG_BT=y
CONFIG_BT_PERIPHERAL=y

# Allow for large Bluetooth data packets.
CONFIG_BT_L2CAP_TX_MTU=498
CONFIG_BT_BUF_ACL_RX_SIZE=502
CONFIG_BT_BUF_ACL_TX_SIZE=502
CONFIG_BT_CTLR_DATA_LENGTH_MAX=251

# Enable the Bluetooth mcumgr transport (unauthenticated).
CONFIG_MCUMGR_TRANSPORT_BT=y
CONFIG_MCUMGR_TRANSPORT_BT_AUTHEN=n
CONFIG_MCUMGR_TRANSPORT_BT_CONN_PARAM_CONTROL=y

# Enable the Shell mcumgr transport.
# CONFIG_BASE64=y
# CONFIG_CRC=y
# CONFIG_SHELL=y
# CONFIG_SHELL_BACKEND_SERIAL=y
# CONFIG_MCUMGR_TRANSPORT_SHELL=y

# Enable the mcumgr Packet Reassembly feature over Bluetooth and its configuration dependencies.
# MCUmgr buffer size is optimized to fit one SMP packet divided into five Bluetooth Write Commands,
# transmitted with the maximum possible MTU value: 498 bytes.
CONFIG_MCUMGR_TRANSPORT_BT_REASSEMBLY=y
CONFIG_MCUMGR_TRANSPORT_NETBUF_SIZE=2475
CONFIG_MCUMGR_GRP_OS_MCUMGR_PARAMS=y
CONFIG_MCUMGR_TRANSPORT_WORKQUEUE_STACK_SIZE=4608

# Enable the LittleFS file system.
CONFIG_FILE_SYSTEM=y
CONFIG_FILE_SYSTEM_LITTLEFS=y

# Enable file system commands
CONFIG_MCUMGR_GRP_FS=y

# Enable the storage erase command.
CONFIG_MCUMGR_GRP_ZBASIC=y
CONFIG_MCUMGR_GRP_ZBASIC_STORAGE_ERASE=y

# Disable Bluetooth ping support
CONFIG_BT_CTLR_LE_PING=n

# Disable shell commands that are not needed
CONFIG_CLOCK_CONTROL_NRF_SHELL=n
CONFIG_DEVICE_SHELL=n
CONFIG_DEVMEM_SHELL=n
CONFIG_FLASH_SHELL=n
```

## overlay-cdc.conf
```kconfig
# Enable USB subsystem
CONFIG_USB_DEVICE_STACK=y
CONFIG_SERIAL=y
CONFIG_UART_LINE_CTRL=y
CONFIG_USB_DEVICE_INITIALIZE_AT_BOOT=n
CONFIG_CONSOLE=y

# USB backend is serial device
CONFIG_MCUMGR_TRANSPORT_UART=y
CONFIG_BASE64=y
CONFIG_CRC=y
```

## usb.overlay
```dts
/*
 * Copyright (c) 2021 Nordic Semiconductor ASA
 *
 * SPDX-License-Identifier: Apache-2.0
 */

/ {
	chosen {
		zephyr,uart-mcumgr = &cdc_acm_uart1;
	};
};

&zephyr_udc0 {
	cdc_acm_uart1: cdc_acm_uart1 {
		compatible = "zephyr,cdc-acm-uart";
	};
};
```

## boards/nrf5340dk_nrf5340_cpuapp.overlay
```dts
/*
 * Copyright (c) 2024 Semtech Corporation
 *
 * SPDX-License-Identifier: Apache-2.0
 */

/ {
    aliases {
        smtc-hal-uart = &uart0;
        smtc-watchdog = &wdt;
        smtc-user-button = &button0;
    };
};
```

## src/example_options.h
```c
/*
 * Copyright (c) 2024 Semtech Corporation
 *
 * SPDX-License-Identifier: Apache-2.0
 */

#ifndef EXAMPLE_OPTIONS_H
#define EXAMPLE_OPTIONS_H

#ifdef __cplusplus
extern "C" {
#endif

/*
 * -----------------------------------------------------------------------------
 * --- DEPENDENCIES ------------------------------------------------------------
 */

#include <stdint.h>   // C99 types
#include <stdbool.h>  // bool type

#include "smtc_modem_api.h"

/*
 * -----------------------------------------------------------------------------
 * --- PUBLIC CONSTANTS --------------------------------------------------------
 */

/**
 * @brief LoRaWAN User credentials
 */

//        0x9e, 0xef, 0x3e, 0xbb, 0x6a, 0x79, 0x1a, 0x18 (Class C)
// 0x04, 0x87, 0x24, 0x2c, 0x62, 0xfa, 0xcf, 0xac  Class B


#define USER_LORAWAN_DEVICE_EUI                        \
    {                                                  \
        0x9e, 0xef, 0x3e, 0xbb, 0x6a, 0x79, 0x1a, 0x18 \
    }

//        0x00, 0x00, 0x00, 0x00, 0x00, 0x00, 0x00, 0x00 (Class C)
// 0xb7, 0x48, 0xbc, 0xf8, 0x69, 0x44, 0xf4, 0xc1 (Class B)

#define USER_LORAWAN_JOIN_EUI                          \
    {                                                  \
        0x00, 0x00, 0x00, 0x00, 0x00, 0x00, 0x00, 0x00 \
    }

#define USER_LORAWAN_GEN_APP_KEY                                                                       \
    {                                                                                                  \
        0x09, 0x00, 0x00, 0x00, 0x00, 0x00, 0x00, 0x00, 0x00, 0x00, 0x00, 0x00, 0x00, 0x00, 0x00, 0x00 \
    }

//        0x1e, 0x8c, 0x22, 0xf2, 0x37, 0x45, 0x92, 0xa6, 0xc0, 0x83, 0x18, 0x08, 0xe3, 0x39, 0x12, 0x54 (Class C)

//        0x23, 0x15, 0xc6, 0x97, 0x36, 0x7d, 0xe8, 0x51, 0xb0, 0xf7, 0x85, 0x8d, 0xb0, 0x43, 0x23, 0x0a (Class B)
#define USER_LORAWAN_APP_KEY                                                                           \
    {                                                                                                  \
        0x1e, 0x8c, 0x22, 0xf2, 0x37, 0x45, 0x92, 0xa6, 0xc0, 0x83, 0x18, 0x08, 0xe3, 0x39, 0x12, 0x54 \
    }

/**
 * @brief Modem Region define
 */
#ifndef MODEM_EXAMPLE_REGION
#if !defined( SX128X )
#define MODEM_EXAMPLE_REGION SMTC_MODEM_REGION_US_915
#else
#define MODEM_EXAMPLE_REGION SMTC_MODEM_REGION_WW2G4
#endif
#endif  // MODEM_EXAMPLE_REGION
// clang-format on

#ifdef __cplusplus
}
#endif

#endif  // EXAMPLE_OPTIONS_H

/* --- EOF ------------------------------------------------------------------ */
```
